## buildroot-external/package/mycroft-skill-contes/Config.in
```kconfig
config BR2_PACKAGE_MYCROFT_SKILL_CONTES
	bool "mycroft-skill-contes"
	help
	  Una mà de contes

	  https://github.com/assistent-cat/skill-contes
```

## buildroot-external/package/python-ovos-stt-plugin-vosk/Config.in
```kconfig
config BR2_PACKAGE_PYTHON_OVOS_STT_PLUGIN_VOSK
	bool "python-ovos-stt-plugin-vosk"
	help
	  Mycroft STT plugin for Vosk

	  https://github.com/OpenVoiceOS/ovos-stt-plugin-vosk
```

## buildroot-external/package/python-ovos-tts-plugin-softcatala/Config.in
```kconfig
config BR2_PACKAGE_PYTHON_OVOS_TTS_PLUGIN_SOFTCATALA
	bool "python-ovos-tts-plugin-softcatala"
	help
	  Mycroft TTS plugin for Softcatala TTS

	  https://github.com/OpenVoiceOS/ovos-tts-plugin-softcatala
```
